// ── HexHound - Roam Mode Unit Tests ─────────────────────────────
//
// Nobody can validate a pedometer from a desk: the only real proof is a human
// walking a counted route with the board in a pocket. What CAN be proved from
// a desk is that the detector does not count things that are obviously not
// steps, and that it does count something that is obviously a walk. That is
// what these tests are for, and it is why StepDetector takes every input as an
// argument instead of reading a clock and an I2C bus of its own.
//
// Four synthetic accelerometer streams are fed through it:
//   * a still device on a desk (sensor noise only)
//   * a walking waveform at a normal cadence
//   * a device being shaken
//   * a device carried at an angle, damped, as in a trouser pocket
//
// Plus the exploration-point maths, which is fully deterministic and can
// simply be asserted: identical radio samples must earn nothing, and a couple
// of access points flickering at the edge of range must earn nothing either.
// That second one is the "sat in the same room for an hour" case and is the
// single most important assertion in this file.

#include "../test_stubs.h"

#include "../../src/modules/roam_module.h"

#include <cmath>

#include "walk_fixture.h"    // REAL counted walks, generated by scripts/gen_step_fixture.py
#include "walk2_fixture.h"
// Spelled out rather than using the platform's pi macro: under -std=c++17
// (strict ISO) MinGW hides that behind _USE_MATH_DEFINES, and a test should
// not depend on which libc the runner happened to build against.
static constexpr double kPi = 3.14159265358979323846;

#define ASSERT_GE(a, b) ASSERT_TRUE((a) >= (b))
#define ASSERT_LE(a, b) ASSERT_TRUE((a) <= (b))

// ── Synthetic accelerometer streams ───────────────────────────────────────

namespace {

// Deterministic small-integer noise. rand() is avoided so a failure is
// reproducible rather than "sometimes".
int noiseAt(int i, int amplitude) {
    // Cheap LCG-ish hash of the sample index, folded into [-amp, +amp].
    uint32_t h = (uint32_t)i * 2654435761u;
    h ^= h >> 13;
    int span = amplitude * 2 + 1;
    return (int)(h % (uint32_t)span) - amplitude;
}

struct Sample { int16_t ax, ay, az; };

// A device lying still: 1 g on one axis plus a few milli-g of ADC noise.
Sample stillSample(int i) {
    Sample s;
    s.ax = (int16_t)noiseAt(i * 3 + 0, 4);
    s.ay = (int16_t)noiseAt(i * 3 + 1, 4);
    s.az = (int16_t)(1000 + noiseAt(i * 3 + 2, 4));
    return s;
}

// A walking waveform. Real gait is not a sine, but the property the detector
// keys on - one dominant vertical acceleration peak per footfall, at a steady
// cadence - is faithfully reproduced by one, and it makes the expected count
// exact rather than a judgement call.
//
// stepHz is footfalls per second; amplitudeMg is peak deviation from 1 g.
Sample walkSample(int i, double dtMs, double stepHz, int amplitudeMg) {
    double t = (i * dtMs) / 1000.0;
    double v = sin(2.0 * kPi * stepHz * t);
    Sample s;
    s.ax = (int16_t)(noiseAt(i * 3 + 0, 12));
    s.ay = (int16_t)(noiseAt(i * 3 + 1, 12));
    s.az = (int16_t)(1000 + (int)(amplitudeMg * v) + noiseAt(i * 3 + 2, 12));
    return s;
}

// The same walk, but with the board at roughly 45 degrees across two axes and
// the amplitude damped by fabric, which is what a phone-pocket carry looks
// like. Magnitude is orientation invariant, so this SHOULD still count; the
// test exists to prove the detector does not secretly depend on gravity
// sitting on the z axis.
Sample pocketSample(int i, double dtMs, double stepHz, int amplitudeMg) {
    double t = (i * dtMs) / 1000.0;
    double v = sin(2.0 * kPi * stepHz * t);
    double mag = 1000.0 + amplitudeMg * v;
    // Split the vector across all three axes: 0.58 each is roughly unit norm.
    Sample s;
    s.ax = (int16_t)(mag * 0.577 + noiseAt(i * 3 + 0, 15));
    s.ay = (int16_t)(mag * 0.577 + noiseAt(i * 3 + 1, 15));
    s.az = (int16_t)(mag * 0.577 + noiseAt(i * 3 + 2, 15));
    return s;
}

// A hand shaking the pet: several g, fast, and irregular in a way a gait is
// not.
Sample shakeSample(int i, double dtMs) {
    double t = (i * dtMs) / 1000.0;
    double v = sin(2.0 * kPi * 5.0 * t);
    double w = sin(2.0 * kPi * 7.3 * t + 1.1);
    Sample s;
    s.ax = (int16_t)(2400 * v + noiseAt(i * 3 + 0, 40));
    s.ay = (int16_t)(1800 * w + noiseAt(i * 3 + 1, 40));
    s.az = (int16_t)(1000 + 2600 * v * w + noiseAt(i * 3 + 2, 40));
    return s;
}

// Feed a stream through the detector at the module's real poll rate.
template <typename F>
uint32_t runStream(StepDetector& d, int samples, double dtMs, F gen) {
    for (int i = 0; i < samples; i++) {
        Sample s = gen(i);
        d.update((uint32_t)(i * dtMs), s.ax, s.ay, s.az);
    }
    return d.steps();
}

constexpr double DT = (double)roamtune::STEP_POLL_MS;   // 50 ms, 20 Hz

} // namespace

// ── Step detector ─────────────────────────────────────────────────────────

TEST(test_isqrt_is_exact_enough) {
    ASSERT_EQ((int)roamIsqrt(0), 0);
    ASSERT_EQ((int)roamIsqrt(1), 1);
    ASSERT_EQ((int)roamIsqrt(1000000), 1000);
    // 1 g on a single axis.
    ASSERT_EQ((int)roamIsqrt(1000u * 1000u), 1000);
    // Floor semantics, not rounding.
    ASSERT_EQ((int)roamIsqrt(99), 9);
}

TEST(test_still_device_counts_no_steps) {
    StepDetector d;
    d.reset();
    // 30 seconds on a desk.
    uint32_t steps = runStream(d, (int)(30000 / DT), DT, [](int i) {
        return stillSample(i);
    });
    ASSERT_EQ((int)steps, 0);
}

TEST(test_still_device_threshold_stays_at_the_floor) {
    StepDetector d;
    d.reset();
    runStream(d, 200, DT, [](int i) { return stillSample(i); });
    // With only ADC noise the dynamic threshold must not creep upward; it
    // should be sitting on its clamp.
    ASSERT_EQ((int)d.threshold(), (int)roamtune::STEP_THRESHOLD_MIN_MG);
}

TEST(test_walking_counts_close_to_the_real_cadence) {
    StepDetector d;
    d.reset();
    // 20 seconds at 2 steps per second = 40 footfalls.
    const int n = (int)(20000 / DT);
    uint32_t steps = runStream(d, n, DT, [](int i) {
        return walkSample(i, DT, 2.0, 350);
    });
    // The warmup discards the first 600 ms, so one footfall is expected to be
    // missed. Anything outside this band is a real regression, not tuning.
    ASSERT_GE((int)steps, 36);
    ASSERT_LE((int)steps, 40);
}

TEST(test_slow_walk_still_counts) {
    StepDetector d;
    d.reset();
    // 20 seconds at 1.2 steps per second = 24 footfalls, smaller amplitude.
    uint32_t steps = runStream(d, (int)(20000 / DT), DT, [](int i) {
        return walkSample(i, DT, 1.2, 260);
    });
    ASSERT_GE((int)steps, 20);
    ASSERT_LE((int)steps, 24);
}

TEST(test_pocket_carry_at_an_angle_still_counts) {
    StepDetector d;
    d.reset();
    // Same 40 footfalls, board at an angle, amplitude damped by fabric.
    uint32_t steps = runStream(d, (int)(20000 / DT), DT, [](int i) {
        return pocketSample(i, DT, 2.0, 240);
    });
    // Looser band than the clean case on purpose: a damped, off-axis carry is
    // genuinely harder and the honest claim is "within a fifth", not "exact".
    ASSERT_GE((int)steps, 32);
    ASSERT_LE((int)steps, 40);
}

TEST(test_shaken_device_does_not_farm_steps) {
    StepDetector d;
    d.reset();
    // 10 seconds of shaking. At 5 Hz a naive threshold detector limited only
    // by the refractory period would report about 40.
    uint32_t steps = runStream(d, (int)(10000 / DT), DT, [](int i) {
        return shakeSample(i, DT);
    });
    ASSERT_LE((int)steps, 2);
}

TEST(test_a_single_bump_is_not_a_step) {
    StepDetector d;
    d.reset();
    // Settle, then one sharp knock, then settle again. Picking the device up
    // off a table must not be worth anything.
    for (int i = 0; i < 200; i++) {
        Sample s = stillSample(i);
        if (i == 100) s.az = (int16_t)(1000 + 600);
        d.update((uint32_t)(i * DT), s.ax, s.ay, s.az);
    }
    ASSERT_EQ((int)d.steps(), 0);
}

TEST(test_refractory_period_rejects_impossible_cadence) {
    StepDetector d;
    d.reset();
    // Warm the detector up on a still stream first.
    for (int i = 0; i < 40; i++) {
        Sample s = stillSample(i);
        d.update((uint32_t)(i * DT), s.ax, s.ay, s.az);
    }
    uint32_t t = 40 * (uint32_t)DT;
    // A 5 Hz vibration: one loud sample, one quiet one, 100 ms apart, so a
    // rising edge every 200 ms. That is 300 footfalls a minute, which no human
    // produces walking.
    //
    // This is the aliasing case, and it is the reason the refractory window is
    // measured edge-to-edge rather than candidate-to-candidate. Measured from
    // the last ACCEPTED step, every second edge clears a 250 ms window and the
    // vibration reads as a brisk 2.5 steps per second indefinitely.
    for (int i = 0; i < 20; i++) {
        bool loud = (i % 2) == 0;
        d.update(t, 0, 0, (int16_t)(loud ? 1000 + 500 : 1000));
        t += 100;
    }
    // The first crossing opens a run; every later one is too close to the
    // crossing before it, so none of them ever become candidates.
    ASSERT_EQ((int)d.steps(), 0);
}

TEST(test_reset_clears_everything) {
    StepDetector d;
    d.reset();
    runStream(d, (int)(20000 / DT), DT, [](int i) {
        return walkSample(i, DT, 2.0, 350);
    });
    ASSERT_TRUE(d.steps() > 0);
    d.reset();
    ASSERT_EQ((int)d.steps(), 0);
    ASSERT_EQ((int)d.samples(), 0);
}

// ── Exploration points ────────────────────────────────────────────────────

TEST(test_identical_radio_sample_earns_nothing) {
    uint16_t a[5] = { 11, 22, 33, 44, 55 };
    roam::Churn c = roam::compare(a, 5, a, 5);
    ASSERT_EQ((int)c.appeared, 0);
    ASSERT_EQ((int)c.vanished, 0);
    ASSERT_EQ((int)c.pct, 0);
    ASSERT_EQ((int)roam::pointsForSample(c, 0, true), 0);
}

TEST(test_same_room_flicker_earns_nothing) {
    // Twenty access points, one of which dropped below the noise floor and one
    // of which came back. This is what a device that has not moved an inch
    // looks like, and it must be worth zero.
    uint16_t prev[20];
    uint16_t cur[20];
    for (int i = 0; i < 20; i++) { prev[i] = (uint16_t)(100 + i); cur[i] = (uint16_t)(100 + i); }
    cur[19] = 999;   // one appeared, one vanished

    roam::Churn c = roam::compare(prev, 20, cur, 20);
    ASSERT_EQ((int)c.appeared, 1);
    ASSERT_EQ((int)c.vanished, 1);
    // 2 changed out of a union of 21 is under 10 percent, well below the floor.
    ASSERT_TRUE(c.pct < roamtune::ROAM_CHURN_FLOOR_PCT);
    ASSERT_EQ((int)roam::pointsForSample(c, 0, true), 0);
}

TEST(test_walking_into_a_new_area_earns_points) {
    uint16_t prev[10];
    uint16_t cur[10];
    for (int i = 0; i < 10; i++) prev[i] = (uint16_t)(200 + i);
    // Half the environment turned over: four carried across, six are new.
    for (int i = 0; i < 4; i++)  cur[i] = prev[i];
    for (int i = 4; i < 10; i++) cur[i] = (uint16_t)(700 + i);

    roam::Churn c = roam::compare(prev, 10, cur, 10);
    ASSERT_EQ((int)c.appeared, 6);
    ASSERT_EQ((int)c.vanished, 6);
    ASSERT_TRUE(c.pct >= roamtune::ROAM_CHURN_FLOOR_PCT);
    ASSERT_TRUE(roam::pointsForSample(c, 0, true) > 0);
}

TEST(test_first_sample_of_a_session_earns_no_churn) {
    uint16_t cur[8];
    for (int i = 0; i < 8; i++) cur[i] = (uint16_t)(300 + i);
    roam::Churn c = roam::compare(nullptr, 0, cur, 8);
    ASSERT_EQ((int)c.appeared, 8);
    // Nothing to compare against yet, so no churn credit. Without this every
    // roam would open with a free jackpot.
    ASSERT_EQ((int)roam::pointsForSample(c, 0, false), 0);
    // Lifetime novelty still counts, because "we have never seen these before"
    // is true regardless of whether there was a previous sample.
    ASSERT_TRUE(roam::pointsForSample(c, 3, false) > 0);
}

TEST(test_points_are_capped_per_sample) {
    uint16_t prev[24];
    uint16_t cur[24];
    for (int i = 0; i < 24; i++) { prev[i] = (uint16_t)(1000 + i); cur[i] = (uint16_t)(5000 + i); }
    roam::Churn c = roam::compare(prev, 24, cur, 24);
    ASSERT_EQ((int)c.pct, 100);
    uint16_t pts = roam::pointsForSample(c, 24, true);
    ASSERT_LE((int)pts, (int)roamtune::ROAM_POINTS_CAP_PER_SAMPLE);
}

TEST(test_lifetime_novelty_beats_pure_churn) {
    // Two samples with identical churn. The one whose identifiers the pet has
    // never seen before must be worth more: that is the whole difference
    // between "somewhere new" and "back and forth across the same corridor".
    uint16_t prev[10];
    uint16_t cur[10];
    for (int i = 0; i < 10; i++) prev[i] = (uint16_t)(400 + i);
    for (int i = 0; i < 5; i++)  cur[i] = prev[i];
    for (int i = 5; i < 10; i++) cur[i] = (uint16_t)(800 + i);

    roam::Churn c = roam::compare(prev, 10, cur, 10);
    uint16_t familiar = roam::pointsForSample(c, 0, true);
    uint16_t novel    = roam::pointsForSample(c, 5, true);
    ASSERT_TRUE(novel > familiar);
}

TEST(test_fingerprint_is_stable_and_never_zero) {
    ASSERT_EQ((int)roam::fingerprintOf("AA:BB:CC:DD:EE:01"),
              (int)roam::fingerprintOf("AA:BB:CC:DD:EE:01"));
    ASSERT_TRUE(roam::fingerprintOf("AA:BB:CC:DD:EE:01") !=
                roam::fingerprintOf("AA:BB:CC:DD:EE:02"));
    // 0 is the empty-slot sentinel, so no real identifier may hash to it.
    ASSERT_TRUE(roam::fingerprintOf("") != 0);
    ASSERT_TRUE(roam::fingerprintOf(nullptr) != 0);
}

// ── The separation rule ───────────────────────────────────────────────────

TEST(test_steps_are_never_derived_from_exploration) {
    // A report shaped like a long, rich expedition on a board with no IMU.
    // The two numbers are independent fields and nothing may bridge them.
    RoamReport r;
    r.pointsEarned  = 4000;
    r.newToPet      = 90;
    r.samples       = 120;
    r.stepsMeasured = false;
    ASSERT_EQ((int)r.stepsTaken, 0);

    // And the capability answer is what a screen must gate on, not the value.
    // On the default test board (T-Dongle S3) there is no IMU at all.
    ASSERT_FALSE(Caps::canMeasureMotion());
}

// ── Runner ────────────────────────────────────────────────────────────────

// ── A real counted walk ───────────────────────────────────────────────────
//
// Everything above this point is synthetic, and synthetic input turned out to be
// incapable of discriminating between tuning constants at all: a clean spike
// clears every threshold, so every candidate parameter set scores identically.
// Only a real pocket, with a real noise floor, tells you anything. This fixture
// is one such walk, 118-119 steps counted by hand.
//
// It is split in two on purpose. A TOTAL is not a measure of correctness here:
// the walk that produced this fixture undercounted the walking phase by 5 and
// then invented 6 steps while the walker sat down, so the total landed on 119
// against 118-119 counted and looked perfect. Scoring on the total would have
// called that a success.
static void replayCapture(int samples, const unsigned short* dt,
                          const short* ax, const short* ay, const short* az,
                          uint32_t walkEndMs,
                          uint32_t* outWalk, uint32_t* outAfter) {
    StepDetector d;
    d.reset();
    uint32_t t = 0, walk = 0, after = 0;
    for (int i = 0; i < samples; i++) {
        t += dt[i];
        const uint8_t committed = d.update(t, ax[i], ay[i], az[i]);
        if (t <= walkEndMs) walk += committed;
        else                after += committed;
    }
    *outWalk = walk;
    *outAfter = after;
}

static void replayFixture(uint32_t* outWalk, uint32_t* outSeated) {
    replayCapture(WALK_FIXTURE_SAMPLES, kWalkDt, kWalkAx, kWalkAy, kWalkAz,
                  WALK_FIXTURE_WALK_END_MS, outWalk, outSeated);
}

static void replayFixture2(uint32_t* outWalk, uint32_t* outStill) {
    replayCapture(WALK2_FIXTURE_SAMPLES, kWalk2Dt, kWalk2Ax, kWalk2Ay, kWalk2Az,
                  WALK2_FIXTURE_WALK_END_MS, outWalk, outStill);
}

static void test_real_walk_counts_close_to_the_counted_truth() {
    uint32_t walk = 0, seated = 0;
    replayFixture(&walk, &seated);
    printf("    real walk: %lu counted by the detector vs %d counted by hand\n",
           (unsigned long)walk, WALK_FIXTURE_COUNTED);

    // A band, not an equality. This is ONE walk by one person in one pocket, and
    // pinning an exact number would make the test a record of that afternoon
    // rather than a statement about the detector.
    //
    // The band is deliberately loose on the low side because the fixture contains
    // four ~411 ms sampling stalls, where the 30 s pet tick dirtied the save and
    // the blocking SPIFFS write starved the step poll. About 2.8 steps are simply
    // not in the data. Tightening this band by lowering the mg floor was tried and
    // REVERTED: it compensates for missing samples by making the detector more
    // eager, which is masking a structural bug with a tuning constant.
    ASSERT_GE((int)walk, (int)(WALK_FIXTURE_COUNTED * 0.90));
    ASSERT_LE((int)walk, (int)(WALK_FIXTURE_COUNTED * 1.06));
}

static void test_real_walk_does_not_invent_steps_while_seated() {
    uint32_t walk = 0, seated = 0;
    replayFixture(&walk, &seated);
    printf("    seated after %d ms: %lu false positives\n",
           WALK_FIXTURE_WALK_END_MS, (unsigned long)seated);

    // The walker sat down at ~100 s and did not walk again. Every step committed
    // after that is invented. Six of them were, before STEP_CADENCE_MIN went from
    // 2 to 3: each false positive committed EXACTLY 2 steps, because two bumps
    // from shifting in a seat satisfied a cadence run of 2 and were paid at once.
    // Requiring three in cadence rejects a two-peak burst outright and costs a
    // real walk only one extra held-back opener.
    //
    // Pinned at 4 rather than 0 because 4 is what the shipping constants actually
    // achieve on this walk. Asserting 0 would be asserting an aspiration.
    ASSERT_LE((int)seated, 4);
}

// ── A second real counted walk ────────────────────────────────────────────
//
// One walk is a calibration. Two walks are a check on it, and this second one
// is why the check was worth having: the first walk's noise floor never rose
// above the mg clamp, so it could not decide STEP_THRESHOLD_NUM at all and
// replayed identically at every ratio in the grid. This walk is louder, the
// ratio decides every crossing, and at the old 1.25x it found 153 of 164.
//
// It also carries the pickup that the owner reported: the capture's own header
// records 155, two more than any real footfall in the file, committed in a
// single event 69 s after walking stopped when the device was picked up. That
// is the STEP_CADENCE_MIN=2 signature, from a board still running the firmware
// that predates the fix.
static void test_second_real_walk_counts_close_to_the_counted_truth() {
    uint32_t walk = 0, still = 0;
    replayFixture2(&walk, &still);
    printf("    real walk 2: %lu counted by the detector vs %d counted by hand\n",
           (unsigned long)walk, WALK2_FIXTURE_COUNTED);

    // Banded on BOTH sides, and the upper bound is the point of the test.
    //
    // Ten sampling stalls cost this capture 2.3 s inside the walking phase.
    // Measuring each hole against the local gait interval (600 ms, 1.67 Hz) says
    // 3-4 footfalls happened while the detector was being fed nothing, so about
    // 161 is the most any detector can honestly find in this file. A parameter
    // set that reports more than that is not more accurate, it is inventing
    // steps to cover samples it never saw - which is exactly how a 1.0x ratio
    // scores 163 here and why it was not taken.
    ASSERT_GE((int)walk, 155);
    ASSERT_LE((int)walk, 162);
}

static void test_second_real_walk_does_not_invent_steps_while_still() {
    uint32_t walk = 0, still = 0;
    replayFixture2(&walk, &still);
    printf("    still after %d ms: %lu false positives "
           "(the capturing firmware's own total was %d)\n",
           WALK2_FIXTURE_WALK_END_MS, (unsigned long)still,
           WALK2_FIXTURE_DEVICE_STEPS);

    // 0, and here that is measured rather than aspirational: the only thing
    // that happened in the 76 s after this walk ended was the device being
    // picked up, and picking a device up is not walking. The firmware that took
    // the capture scored it 2. This is the regression guard for that report.
    ASSERT_LE((int)still, 0);
}

// Every way an expedition can end must say something different, because the
// whole point of the field is telling those cases apart afterwards. A new
// RoamEnd value that falls through to the default would render as "ended" and
// quietly put us back where this started.
static void test_every_end_reason_has_its_own_words() {
    const uint8_t reasons[] = {ROAM_END_USER, ROAM_END_DURATION,
                               ROAM_END_BATTERY, ROAM_END_REFUSED};
    const char* fallback = roamEndReasonName(0xFF);
    for (unsigned i = 0; i < sizeof(reasons); i++) {
        const char* a = roamEndReasonName(reasons[i]);
        ASSERT_TRUE(a != nullptr && a[0] != '\0');
        ASSERT_TRUE(strcmp(a, fallback) != 0);
        for (unsigned j = i + 1; j < sizeof(reasons); j++) {
            ASSERT_TRUE(strcmp(a, roamEndReasonName(reasons[j])) != 0);
        }
        // The narrowest panel is 160x80: 26 columns at text size 1, shared with
        // a "MM:SS  " clock. Anything longer than this silently runs off it.
        ASSERT_LE((int)strlen(a), 13);
    }
}

int main() {
    printf("\n=== Roam Mode Tests ===\n");

    printf("\n-- step detector --\n");
    RUN_TEST(test_isqrt_is_exact_enough);
    RUN_TEST(test_still_device_counts_no_steps);
    RUN_TEST(test_still_device_threshold_stays_at_the_floor);
    RUN_TEST(test_walking_counts_close_to_the_real_cadence);
    RUN_TEST(test_slow_walk_still_counts);
    RUN_TEST(test_pocket_carry_at_an_angle_still_counts);
    RUN_TEST(test_shaken_device_does_not_farm_steps);
    RUN_TEST(test_a_single_bump_is_not_a_step);
    RUN_TEST(test_refractory_period_rejects_impossible_cadence);
    RUN_TEST(test_reset_clears_everything);

    printf("\n-- a REAL counted walk --\n");
    RUN_TEST(test_real_walk_counts_close_to_the_counted_truth);
    RUN_TEST(test_real_walk_does_not_invent_steps_while_seated);
    RUN_TEST(test_second_real_walk_counts_close_to_the_counted_truth);
    RUN_TEST(test_second_real_walk_does_not_invent_steps_while_still);

    printf("\n-- exploration points --\n");
    RUN_TEST(test_identical_radio_sample_earns_nothing);
    RUN_TEST(test_same_room_flicker_earns_nothing);
    RUN_TEST(test_walking_into_a_new_area_earns_points);
    RUN_TEST(test_first_sample_of_a_session_earns_no_churn);
    RUN_TEST(test_points_are_capped_per_sample);
    RUN_TEST(test_lifetime_novelty_beats_pure_churn);
    RUN_TEST(test_fingerprint_is_stable_and_never_zero);

    printf("\n-- separation of the two earners --\n");
    RUN_TEST(test_steps_are_never_derived_from_exploration);

    printf("\n-- why an expedition ended --\n");
    RUN_TEST(test_every_end_reason_has_its_own_words);

    // Printed, not asserted. These are the numbers a human should compare
    // against a counted walk before touching the tuning block; the assertions
    // above only pin the bands, and a count drifting inside its band is still
    // worth seeing.
    printf("\n-- observed counts (synthetic, for calibration reference) --\n");
    struct { const char* label; double hz; int amp; bool pocket; int truth; } cases[] = {
        { "walk 2.0Hz 350mg upright", 2.0, 350, false, 40 },
        { "walk 1.2Hz 260mg upright", 1.2, 260, false, 24 },
        { "walk 2.6Hz 420mg upright", 2.6, 420, false, 52 },
        { "walk 2.0Hz 240mg pocket",  2.0, 240, true,  40 },
        { "walk 1.2Hz 180mg pocket",  1.2, 180, true,  24 },
    };
    for (auto& c : cases) {
        StepDetector d;
        d.reset();
        int n = (int)(20000 / DT);
        for (int i = 0; i < n; i++) {
            Sample s = c.pocket ? pocketSample(i, DT, c.hz, c.amp)
                                : walkSample(i, DT, c.hz, c.amp);
            d.update((uint32_t)(i * DT), s.ax, s.ay, s.az);
        }
        printf("  %-26s truth %3d  counted %3lu  (%+d)\n",
               c.label, c.truth, (unsigned long)d.steps(),
               (int)d.steps() - c.truth);
    }

    printf("\n=== %d passed, %d failed ===\n\n", s_testsPassed, s_testsFailed);
    return s_testsFailed > 0 ? 1 : 0;
}
