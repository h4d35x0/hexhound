#include "ui_den.h"
#include "ui_utils.h"
#include "ui_round.h"
#include "ui_inventory.h"   // itemIconFor(), UI_ITEM_ICON_PX
#include "animator.h"       // drawSprite(), drawSpriteResized(), getStageHomeHD()
#include "den_art.h"        // den_tile_*, DEN_COL_* - include from HERE ONLY
#include "ui_worn.h"        // drawWornOn()

#include <stdio.h>
#include <string.h>

// ── HexHound - Den Screen Implementation ────────────────────────
//
// The rules live in ui_den.h as free functions so they can be tested without a
// display. This file is only pixels.

#define COL_HEADER   0x07FF   // cyan
#define COL_DIVIDER  0x07FF   // cyan
#define COL_SEL      0x07FF   // cyan  - the cursor
#define COL_TEXT     0xFFFF   // white
#define COL_DIM      0xC618   // light grey - the empty note

// Icons and tiles are generated by two different scripts into two different
// headers. They are sized by the same panel-family rule, and a slot laid out
// for one size holding an icon of the other would sit off its shelf.
static_assert(UI_ITEM_ICON_PX == DEN_TILE_PX,
              "item icons and den tiles disagree on the panel family size; "
              "re-run scripts/gen_item_icons.py and scripts/gen_den_art.py");

// ── Room scale ────────────────────────────────────────────────────────────
//
// DEN_SCALE is how much bigger this panel's room is than the 240 round one. It
// is 1 on every rectangular panel and on the 240 round one, so every expression
// below reduces to exactly what it was before on those boards, which is the
// only proof that a shipping board did not quietly move.
//
// It sizes the room's GEOMETRY - hairlines, insets, bracket arms, label text -
// and no longer sizes its ART. The tiles and the item icons used to be one
// 16 px set enlarged here to fill the 480 glass; both are now baked per panel
// family at the size they are drawn (8, 16 or 32 px), so DEN_TILE_PX and
// UI_ITEM_ICON_PX are the source AND the destination size and nothing on this
// screen enlarges anything. Blowing the icons up was the expensive half: they
// are supersampled and LANCZOS-downscaled, so doubling them turned every graded
// edge pixel into a 2x2 block. The drawn sizes are unchanged, so no layout
// moved; only the pixels got sharper.
//
// It is a MACRO rather than a constexpr because a place below has to emit
// DIFFERENT CODE, not just different numbers, and only the preprocessor can
// drop the branch it does not take. Leaving that decision to the optimiser was
// measured, and it was not free: a run-time branch on a compile-time-equal pair
// of sizes, plus a loop that runs once, cost the 240 board 80 bytes.
#if HEXHOUND_PANEL_ROUND
#define DEN_SCALE (SCREEN_W / 240)
static_assert(DEN_SCALE == uiround::TEXT_SCALE,
              "den art scale and round text scale must move together, or the "
              "room and its labels grow at different rates");
#else
#define DEN_SCALE 1
#endif

// What lands on glass. Equal to what the headers hold, by construction - see
// above - so there is no SRC/PX split left to get backwards.
static constexpr int TILE_PX = DEN_TILE_PX;
static constexpr int ICON_PX = UI_ITEM_ICON_PX;

// The room grows with DEN_SCALE but the art only grows when somebody bakes a
// set for the new size, and those two facts live in different files. This is
// what stops a future, larger round panel from laying out a room at 3x and then
// filling it with the 240 tiles at a third of the size it planned for: the
// build fails instead, naming the generators that have to be run.
static_assert(DEN_SCALE == 1 || TILE_PX == 16 * DEN_SCALE,
              "this panel's room is scaled up but its tiles and icons are not; "
              "add the size to SIZES in scripts/gen_den_art.py and "
              "scripts/gen_item_icons.py and re-run both");

// Hairlines and small offsets scale with the art, or the room grows while its
// details stay 1 px and the whole thing reads as a photograph of a smaller den.
static constexpr int DEN_HAIR = DEN_SCALE;

// Copy src into dst, clipped to maxPx pixels at charPx per glyph, ending in
// ".." when it did not fit. Same helper shape as ui_inventory.cpp and
// ui_quests.cpp, kept local for the same reason they keep theirs local: it is
// four lines, and hoisting it would mean editing two screens this workstream
// does not own.
static void fitText(char* dst, size_t dstSz, const char* src,
                    int maxPx, int charPx) {
    if (!dst || dstSz == 0) return;
    dst[0] = '\0';
    if (!src || charPx <= 0) return;

    int maxChars = maxPx / charPx;
    if (maxChars < 1) return;
    if ((size_t)maxChars > dstSz - 1) maxChars = (int)dstSz - 1;

    const int len = (int)strlen(src);
    if (len <= maxChars) {
        memcpy(dst, src, (size_t)len);
        dst[len] = '\0';
        return;
    }
    if (maxChars <= 2) {
        memcpy(dst, src, (size_t)maxChars);
        dst[maxChars] = '\0';
        return;
    }
    memcpy(dst, src, (size_t)(maxChars - 2));
    dst[maxChars - 2] = '.';
    dst[maxChars - 1] = '.';
    dst[maxChars]     = '\0';
}

// ── The room ──────────────────────────────────────────────────────────────

// Fill a rectangle with a seamless tile, clipped exactly to the rectangle.
//
// Phase-locked to ABSOLUTE screen coordinates rather than to the rectangle's
// own origin, so the wall band, the rail band and the floor band all land on
// the same lattice and the room reads as one surface instead of three strips.
// Runs of one colour go out as a single fillRect, the same trick drawSprite()
// uses: a tile row is mostly flat, so a 240 px row of wall costs about two
// calls per tile instead of sixteen.
//
// x0 and y0 are screen coordinates and never negative here, so the modulo does
// not need the sign fix-up.
//
// The lattice period is TILE_PX, which is both the drawn and the baked size, so
// a screen pixel maps to a source texel directly. This used to divide by
// DEN_SCALE to undo the enlargement; the 480 panel has its own 32 px tiles now,
// so there is no enlargement to undo.
static void tileBand(TFT_eSPI& t, int x0, int y0, int w, int h,
                     const uint16_t* tile) {
    if (w <= 0 || h <= 0) return;
    for (int y = 0; y < h; y++) {
        const uint16_t* row = &tile[((y0 + y) % TILE_PX) * TILE_PX];
        int x = 0;
        while (x < w) {
            const uint16_t c = pgm_read_word(&row[(x0 + x) % TILE_PX]);
            int run = 1;
            while (x + run < w &&
                   pgm_read_word(&row[(x0 + x + run) % TILE_PX]) == c) {
                run++;
            }
            t.fillRect(x0 + x, y0 + y, run, 1, c);
            x += run;
        }
    }
}

// Where everything in the room goes. Computed per draw rather than stored:
// it is a dozen integers derived from compile-time constants and the tier, and
// caching it would be a second copy of the layout to keep in step.
struct DenLayout {
    int roomTop  = 0;   // first row of the room
    int roomBot  = 0;   // one past the last row of the room
    int railY    = 0;   // top of the horizon band; the band is TILE_PX tall
    int petX     = 0;
    int petY     = 0;
    int petPx    = 0;   // drawn size; <= HD_HOME_PX, resized when the room is short
    uint8_t cols = 1;
    uint8_t rows = 1;
    int cellW    = 0;
    int gridX    = 0;   // left edge of the slot grid
    int rowBase[2] = { 0, 0 };   // the shelf / floor line each row stands on
};

// The horizon sits a little above the middle of the room, so the floor - where
// most of the objects stand - gets the deeper half.
static int railFor(int roomTop, int roomH) {
    return roomTop + (roomH * 45) / 100;
}

// The pet stands with its feet in the middle of the horizon band, and is
// resized down if the wall above the horizon is shorter than the HD art. Every
// panel therefore gets the largest pet its room can hold rather than a clipped
// one, and the resize is free on the panels where it does not happen.
static void placePet(DenLayout& L, int maxPx) {
    int px = (HD_HOME_PX < maxPx) ? HD_HOME_PX : maxPx;
    const int headroom = L.railY + TILE_PX / 2 - L.roomTop;
    if (px > headroom) px = headroom;
    if (px < 8) px = 8;
    L.petPx = px;
    L.petY  = L.railY + TILE_PX / 2 - px;
}

static void drawRoom(TFT_eSPI& t, const DenLayout& L) {
    tileBand(t, 0, L.roomTop, SCREEN_W, L.railY - L.roomTop, den_tile_wall);
    tileBand(t, 0, L.railY, SCREEN_W, TILE_PX, den_tile_rail);
    tileBand(t, 0, L.railY + TILE_PX, SCREEN_W,
             L.roomBot - L.railY - TILE_PX, den_tile_floor);
}

static void drawPet(TFT_eSPI& t, const DenLayout& L) {
    const PetStage stage = PetCore::instance().state().stage;

    // A grounding shadow first, so the pet is standing on the floor rather
    // than floating in front of a picture of one. Three shrinking bands is
    // enough to read as contact at 24 px and still not muddy at 72 px.
    const int cx = L.petX + L.petPx / 2;
    const int fy = L.petY + L.petPx;
    for (int i = 0; i < 3; i++) {
        const int hw = L.petPx / 3 - i * (L.petPx / 10) - 1;
        if (hw > 0) {
            t.fillRect(cx - hw, fy - 2 * DEN_HAIR + i * DEN_HAIR,
                       hw * 2, DEN_HAIR, DEN_COL_SHADOW);
        }
    }

    const uint16_t* art = getStageHomeHD(stage);
    if (L.petPx == HD_HOME_PX) {
        drawHDArt(t, art, L.petX, L.petY, HD_HOME_SRC_PX, HD_HOME_PX);
    } else {
        drawSpriteResized(t, art, HD_HOME_SRC_PX, HD_HOME_SRC_PX,
                          L.petX, L.petY, L.petPx, L.petPx);
    }
    // Whatever it is wearing comes with it into its own room. L.petPx, not
    // HD_HOME_PX: the den resizes the pet down when the room is short, and the
    // overlay is placed in thousandths of the size actually drawn.
    drawWornOn(t, stage, L.petX, L.petY, L.petPx);
}

// One placement slot, centred on cx and standing on baseY.
//
// The corner brackets are the affordance: they say "an object goes here" when
// the slot is empty, and they become the cursor when it is selected. That is
// why an EMPTY den is a room and not a blank wall - every slot the board shows
// is visibly a place, whether or not anything is in it.
static void drawSlot(TFT_eSPI& t, int cx, int baseY, uint8_t itemId,
                     bool selected, int labelW, uint16_t plate) {
    const int x0 = cx - ICON_PX / 2;
    const int y0 = baseY - ICON_PX;
    const bool empty = (itemId == DEN_SLOT_EMPTY);

    // The shelf the object stands on. Lit when selected so the cursor reads
    // even on a slot whose item already fills its brackets.
    const int over = 3 * DEN_SCALE;
    t.drawFastHLine(x0 - over, baseY, ICON_PX + over * 2,
                    selected ? COL_SEL : DEN_COL_RAIL);
#if DEN_SCALE > 1
    // The shelf is part of the art, not a rule, so it thickens with the room
    // instead of staying a hairline under a doubled icon.
    for (int i = 1; i < DEN_SCALE; i++) {
        t.drawFastHLine(x0 - over, baseY + i, ICON_PX + over * 2,
                        selected ? COL_SEL : DEN_COL_RAIL);
    }
#endif

    if (!empty) {
        // A plain blit on every panel: the icon is baked at ICON_PX for this
        // panel family, so there is no enlargement left to do. The 480 room
        // used to reach drawSpriteResized() here and stand 16 px art on a 32 px
        // shelf, which is what made the furniture look like a screenshot of a
        // smaller den.
        if (const uint16_t* icon = itemIconFor(itemId)) {
            drawSprite(t, icon, x0, y0, ICON_PX, ICON_PX);
        }
    }

    if (empty || selected) {
        const uint16_t c = selected ? COL_SEL : DEN_COL_RIVET;
        const int inset = 2 * DEN_SCALE;
        const int bx0 = x0 - inset, by0 = y0 - inset;
        const int bx1 = x0 + ICON_PX + inset - 1, by1 = y0 + ICON_PX + inset - 1;
        const int len = ((ICON_PX >= 16) ? 5 : 3) * DEN_SCALE;
        t.drawFastHLine(bx0, by0, len, c);
        t.drawFastVLine(bx0, by0, len, c);
        t.drawFastHLine(bx1 - len + 1, by0, len, c);
        t.drawFastVLine(bx1, by0, len, c);
        t.drawFastHLine(bx0, by1, len, c);
        t.drawFastVLine(bx0, by1 - len + 1, len, c);
        t.drawFastHLine(bx1 - len + 1, by1, len, c);
        t.drawFastVLine(bx1, by1 - len + 1, len, c);
    }

    // A name under the object, where the panel is wide enough for one. The
    // 160x80 passes labelW = 0: at 6 px per glyph a 41 px cell holds six
    // characters, and "FARAD.." under a lamp is noise, so that panel names the
    // selected slot in the footer instead.
    //
    // `plate` is the room colour BEHIND this row. Neither TFT_eSPI wrapper in
    // this firmware has a transparent-text path (setTextColor(fg) fills with
    // black), so a label drawn the obvious way would stamp a black rectangle
    // into the middle of the floor. Painting it in the surface's own base
    // colour is what makes the label sit ON the room instead of punching a
    // hole in it.
    if (labelW <= 0 || empty) return;
    const char* name = Inventory::instance().nameFor(itemId);
    char buf[20];
    fitText(buf, sizeof(buf), name, labelW, 6 * DEN_SCALE);
    if (!buf[0]) return;
    t.setTextSize(DEN_SCALE);
    t.setTextColor(selected ? COL_SEL : COL_TEXT, plate);
    t.setCursor(cx - (int)strlen(buf) * 3 * DEN_SCALE, baseY + 3 * DEN_SCALE);
    t.print(buf);
}

// ── Screen ────────────────────────────────────────────────────────────────

UIDen& UIDen::instance() {
    static UIDen ui;
    return ui;
}

void UIDen::init(TFT_eSPI* tft) {
    _tft = tft;
}

void UIDen::open() {
    _cursor = 0;
    draw();
}

// Keep the cursor on a position that still exists.
//
// The room is no longer a fixed size (see denRoomSlots): clearing the last slot
// of a full room, or crafting, changes how many positions there are while the
// cursor is sitting on one of them. Without this a cleared slot could leave the
// cursor one past the end, where selectedKind() reports BACK and the footer
// describes a row that is not drawn.
void UIDen::clampCursor() {
    const int total = entryCount();
    if (total <= 0) { _cursor = 0; return; }
    if (_cursor >= total) _cursor = total - 1;
    if (_cursor < 0)      _cursor = 0;
}

void UIDen::scrollDown() {
    clampCursor();
    const int total = entryCount();
    if (total <= 0) return;
    _cursor = (_cursor + 1) % total;
    draw();
}

DenRowKind UIDen::selectedKind(uint8_t* slot) const {
    if (_cursor <= 0) return DEN_ROW_BACK;
    const int s = _cursor - 1;
    if (s < (int)visibleSlots()) {
        if (slot) *slot = (uint8_t)s;
        return DEN_ROW_SLOT;
    }
    return DEN_ROW_BACK;
}

DenResult UIDen::act() {
    uint8_t slot = 0;
    if (selectedKind(&slot) != DEN_ROW_SLOT) return DEN_NOT_A_SLOT;

    PetState& st = PetCore::instance().state();
    const uint8_t raw    = st.denSlots[slot];
    const uint8_t before = denItemAt(st, slot);
    const uint8_t next   = denNextForSlot(st, slot);

    if (next == before) {
        // Nothing to move. Normalise a slot holding an id this firmware cannot
        // place - a save from a newer build, or a corrupt byte - so the array
        // matches the room that is already being drawn, then say WHY nothing
        // moved. Owning no den cosmetics is normal early on and has to be
        // reported, not swallowed.
        if (raw != next) {
            st.denSlots[slot] = next;
            st.dirty = true;
        }
        return (denOwnedCount() == 0) ? DEN_NONE_OWNED : DEN_NONE_FREE;
    }

    st.denSlots[slot] = next;
    st.dirty = true;
    clampCursor();
    draw();

    if (next == DEN_SLOT_EMPTY)   return DEN_OK_CLEARED;
    if (before == DEN_SLOT_EMPTY) return DEN_OK_PLACED;
    return DEN_OK_SWAPPED;
}

const char* UIDen::actionHint() const {
    uint8_t slot = 0;
    if (selectedKind(&slot) != DEN_ROW_SLOT) return "hold=back";

    const PetState& st = PetCore::instance().state();
    if (denOwnedCount() == 0) return "craft one";

    const uint8_t next = denNextForSlot(st, slot);
    if (next == DEN_SLOT_EMPTY) {
        // Cycling off the end of the list empties the slot, which is how a
        // one-verb interface removes something. Say so rather than "all out",
        // which read as a refusal when it is actually the clear step.
        // Nothing left to offer this slot. "all out" read as a fault; what it
        // actually means is that every den item you own is already standing
        // somewhere, so the next step is to make another one.
        return denItemAt(st, slot) != DEN_SLOT_EMPTY ? "hold=clear" : "craft more";
    }

    // NAME the item a hold would put here. The slot cycles through everything
    // owned, so this is the chooser - but only if it tells you what is coming.
    // Without it a hold looked like it simply dropped one of your items in and
    // gave you no say, which is exactly how it was reported.
    //
    // A static buffer because the caller wants a const char*, same as every
    // other branch here; this is single-threaded UI code drawn once per frame.
    static char buf[20];
    char word[14];
    itemFirstWord(Inventory::instance().nameFor(next), word, sizeof(word));
    snprintf(buf, sizeof(buf), "hold:%s", word);
    return buf;
}

const char* UIDen::resultText(DenResult r) {
    switch (r) {
        case DEN_OK_PLACED:   return "placed";
        case DEN_OK_SWAPPED:  return "swapped";
        case DEN_OK_CLEARED:  return "put away";
        case DEN_NOT_A_SLOT:  return "nothing there";
        case DEN_NONE_OWNED:  return "craft a den item first";
        case DEN_NONE_FREE:   return "all out - craft another";
    }
    return "-";
}

void UIDen::footerLeft(char* buf, size_t n) const {
    const PetState& st = PetCore::instance().state();
    const uint8_t visible = visibleSlots();

    uint8_t slot = 0;
    if (selectedKind(&slot) == DEN_ROW_SLOT) {
        const uint8_t id = denItemAt(st, slot);
        if (id != DEN_SLOT_EMPTY) {
            snprintf(buf, n, "%s", Inventory::instance().nameFor(id));
            return;
        }
        // An empty slot with nothing free to put in it should say how much of
        // the room is already furnished, not just "empty slot" - otherwise the
        // only two words on screen are "empty" and "craft more", and neither
        // tells you that the things you made are already out.
        if (denNextForSlot(st, slot) == DEN_SLOT_EMPTY && denOwnedCount() > 0) {
            // Count the ITEMS, not the slots. "3 of 8 out" invites the reading
            // "three of my eight items", and the room has more slots than there
            // are den cosmetics in the game, so that number would be a
            // permanent accusation that something is missing. "all 3 placed"
            // says the true and useful thing: everything you own is down, and
            // the empty brackets are waiting on a recipe, not on you.
            snprintf(buf, n, "all %u placed", (unsigned)denOwnedCount());
        } else {
            snprintf(buf, n, "empty slot");
        }
        return;
    }

    // The denominator is ITEMS OWNED, never slots.
    //
    // This line said "%u of %u out" against the SLOT count, and it is the line
    // actually on screen when the cursor is on BACK - which is the one that got
    // photographed and read, correctly, as "three of my five things are out,
    // where are the other two". The slot-selected branch above had already been
    // changed for exactly this reason and this one was missed.
    //
    // Against slots the number is unfixable: the room has more places than the
    // game has furniture, so it would permanently report a shortfall that no
    // amount of play could close. Against what you own it is always true and
    // always actionable.
    const uint8_t placed = denPlacedCount(st, visible);
    const uint8_t owned  = denOwnedCount();
    if (owned == 0) {
        snprintf(buf, n, "empty den");
    } else if (placed >= owned) {
        snprintf(buf, n, "all %u placed", (unsigned)owned);
    } else {
        snprintf(buf, n, "%u of %u placed", (unsigned)placed, (unsigned)owned);
    }
}

void UIDen::draw() {
    if (!_tft) return;
#if HEXHOUND_PANEL_ROUND
    drawRound();
#else
    drawRect();
#endif
}

#if !HEXHOUND_PANEL_ROUND

// ── Rectangular panels (160x80 and 320x172) ───────────────────────────────
//
// One layout at two scales, exactly like ui_inventory: the pet stands on the
// left against the horizon, and the slot grid fills the rest of the room. A
// board showing more than four slots gets a second row, and that row is on the
// WALL rather than squeezed onto the floor - so a rich board's den reads as a
// shelf above and a floor below, which is what a room looks like.

void UIDen::drawRect() {
    const bool big   = (SCREEN_H > 100);
    const int  pad   = big ? uilg::PAD : 4;
    const int  charW = big ? uilg::CHAR_W : 6;
    const uint8_t visible = visibleSlots();

    DenLayout L;
    L.roomTop = (big ? uilg::HEADER_DIV : 12) + 1;
    L.roomBot = big ? uilg::FOOTER_DIV : (SCREEN_H - 12);
    L.railY   = railFor(L.roomTop, L.roomBot - L.roomTop);

    L.petX = pad;
    placePet(L, big ? 64 : HD_HOME_PX);

    L.rows  = (visible > 4) ? 2 : 1;
    L.cols  = (uint8_t)((visible + L.rows - 1) / L.rows);
    L.gridX = L.petX + L.petPx + pad;
    L.cellW = (SCREEN_W - pad - L.gridX) / (L.cols > 0 ? L.cols : 1);

    // The last row always stands on the floor; a second row is a shelf on the
    // wall, clear of the horizon.
    const int floorTop = L.railY + TILE_PX;
    const int floorH   = L.roomBot - floorTop;
    const int floorRow = floorTop + (floorH + ICON_PX) / 2;
    if (L.rows == 2) {
        L.rowBase[0] = L.railY - (big ? 14 : 6);
        L.rowBase[1] = floorRow;
    } else {
        L.rowBase[0] = floorRow;
    }

    _tft->fillScreen(TFT_BLACK);
    drawRoom(*_tft, L);
    drawPet(*_tft, L);

    // Labels only where a cell is wide enough to say something true. Eight
    // glyphs is the floor: below that every name is an ellipsis. The 6 px
    // taken off the cell is a GUTTER, not padding - at the full cell width the
    // labels of four adjacent 60 px cells butt together and read as one line.
    // Six is the smallest gutter that separates them and still leaves room for
    // "DESK LAMP", the one den item whose whole name fits.
    const int labelW = (L.cellW >= 8 * 6) ? (L.cellW - 6) : 0;

    const PetState& st = PetCore::instance().state();
    const uint8_t placed = denPlacedCount(st, visible);
    uint8_t selSlot = 0;
    const bool onSlot = (selectedKind(&selSlot) == DEN_ROW_SLOT);

    for (uint8_t s = 0; s < visible; s++) {
        const int r  = (L.rows == 2) ? (s / L.cols) : 0;
        const int c  = (L.rows == 2) ? (s % L.cols) : s;
        const int cx = L.gridX + c * L.cellW + L.cellW / 2;
        // A second row is on the wall, so its label plate is wall colour.
        const uint16_t plate = (L.rows == 2 && r == 0) ? DEN_COL_WALL
                                                       : DEN_COL_FLOOR;
        drawSlot(*_tft, cx, L.rowBase[r], denItemAt(st, s),
                 onSlot && selSlot == s, labelW, plate);
    }

    // ── Chrome ────────────────────────────────────────────────────────────
    char cnt[10];
    snprintf(cnt, sizeof(cnt), "%u/%u", (unsigned)placed, (unsigned)visible);

    if (big) {
        uiBigHeader(*_tft, "DEN", COL_HEADER);
    } else {
        _tft->setTextSize(1);
        _tft->setTextColor(COL_HEADER, TFT_BLACK);
        _tft->setCursor(4, 2);
        _tft->print("DEN");
        _tft->drawFastHLine(0, 12, SCREEN_W, COL_DIVIDER);
    }
    _tft->setTextSize(big ? 2 : 1);
    _tft->setTextColor(COL_TEXT, TFT_BLACK);
    _tft->setCursor(SCREEN_W - (int)strlen(cnt) * charW - pad,
                    big ? uilg::TITLE_Y : 2);
    _tft->print(cnt);

    char left[28];
    footerLeft(left, sizeof(left));
    const char* hint = actionHint();
    // Dim only when the left half is the "empty den" note, matching how
    // ui_inventory dims "nothing carried". An informative line stays white.
    const uint16_t leftCol = (placed == 0 && !onSlot) ? COL_DIM : COL_TEXT;

    if (big) {
        uiBigFooter(*_tft, left, hint, leftCol);
        return;
    }

    // Compact footer. The hint is fixed width, so the left half gets whatever
    // is left rather than a guessed column: on this panel an item name and the
    // hint together are the widest line on the screen.
    const int footerY = SCREEN_H - 10;
    const int hintW   = (int)strlen(hint) * 6;
    _tft->fillRect(0, footerY - 2, SCREEN_W, SCREEN_H - footerY + 2, TFT_BLACK);
    _tft->drawFastHLine(0, footerY - 2, SCREEN_W, COL_DIVIDER);
    char lbuf[28];
    fitText(lbuf, sizeof(lbuf), left, SCREEN_W - hintW - 12, 6);
    _tft->setTextSize(1);
    _tft->setTextColor(leftCol, TFT_BLACK);
    _tft->setCursor(4, footerY);
    _tft->print(lbuf);
    _tft->setTextColor(COL_TEXT, TFT_BLACK);
    _tft->setCursor(SCREEN_W - hintW - 4, footerY);
    _tft->print(hint);
}

#endif  // !HEXHOUND_PANEL_ROUND

#if HEXHOUND_PANEL_ROUND

// ── Round panels (240x240 and 480x480) ────────────────────────────────────
//
// A grid in a circle wastes the circle, so the round den arranges the slots as
// a RING around the pet: the pet is in the middle of its room and its
// belongings are on the walls and floor around it. It is the same idea as the
// rim gauges on the home screen, and it is the one layout where the round
// glass is an advantage.
//
// ── Why the ring is an ELLIPSE ────────────────────────────────────────────
//
// A true circle only works for a slot count whose positions happen to miss 12
// and 6 o'clock, where the title and the footer live. A circle of radius 64
// centred at y=119 is fine for 8 slots offset by half a step, and puts the
// third of three slots at y=183 - straight through the footer rule at 190.
// Tuning the start angle per count would be a table of magic numbers that the
// next slot count silently invalidates.
//
// Squashing the ring vertically removes the problem instead of dodging it: the
// EXTREMES are bounded, so every slot is inside the body band for every count,
// including counts nobody has picked yet. rx=68, ry=52 about (CX, 119) puts
// every icon box inside y 59..179 against a body of 49..190, and inside
// x 44..196 against a chord of at least 6..234 over that band.
//
// Those numbers are 240-relative, so every one of them goes through
// uiround::scaled() and the 480 panel gets the same ring as a fraction of its
// glass. Written as raw pixels they would have drawn a 240-sized ring in the
// middle of a 480 screen, which is the same bug the room had.
static constexpr int RING_CX = uiround::CX;
static constexpr int RING_CY = uiround::scaled(119);
static constexpr int RING_RX = uiround::scaled(68);
static constexpr int RING_RY = uiround::scaled(52);
static_assert(uiround::DIAM != 240 ||
                  (RING_CY == 119 && RING_RX == 68 && RING_RY == 52),
              "240 den ring geometry shifted");

// The pet sits inside the ring. 72 px puts its corners 51 px from the centre,
// against an inner icon edge at ry - ICON_PX/2 - 2 = 42 straight down and
// rx - 10 = 58 straight out; the diagonal slots clear it because they are the
// ones furthest from the pet's flat sides.
static constexpr int ROUND_PET_PX = uiround::scaled(72);
static_assert(uiround::DIAM != 240 || ROUND_PET_PX == 72,
              "240 den pet size shifted");

void UIDen::drawRound() {
    const uint8_t visible = visibleSlots();

    DenLayout L;
    L.roomTop = uiround::HEADER_DIV + 1;
    L.roomBot = uiround::FOOTER_DIV;

    // The pet is centred in the ring, so the horizon is placed around IT
    // rather than the other way round. Two thirds of the way down the pet puts
    // the horizon BEHIND it, so the pet stands on the floor in front of the
    // back wall instead of being glued flat against it - which is both better
    // perspective and the only way this panel gets a floor worth the name.
    L.petPx = ROUND_PET_PX;
    L.petX  = RING_CX - L.petPx / 2;
    L.petY  = RING_CY - L.petPx / 2;
    L.railY = L.petY + (L.petPx * 2) / 3;

    _tft->fillScreen(TFT_BLACK);
    drawRoom(*_tft, L);
    drawPet(*_tft, L);

    const PetState& st = PetCore::instance().state();
    const uint8_t placed = denPlacedCount(st, visible);
    uint8_t selSlot = 0;
    const bool onSlot = (selectedKind(&selSlot) == DEN_ROW_SLOT);

    const float step = 360.0f / (float)(visible > 0 ? visible : 1);
    for (uint8_t s = 0; s < visible; s++) {
        const float a = (-90.0f + step * (float)s) * (float)PI / 180.0f;
        const int x = RING_CX + (int)(RING_RX * cosf(a));
        const int y = RING_CY + (int)(RING_RY * sinf(a));
        // baseY, not centre: drawSlot() stands an object on a shelf, and a
        // ring of objects standing on little shelves reads as a room rather
        // than as a dial of floating icons.
        drawSlot(*_tft, x, y + ICON_PX / 2, denItemAt(st, s),
                 onSlot && selSlot == s, 0, DEN_COL_WALL);
    }

    uiround::header(*_tft, "DEN", COL_HEADER);

    // No separate slot counter on this panel. The footer already carries it
    // whenever the cursor is on BACK, and a text plate anywhere else on the
    // glass would stamp a rectangle into the tiled room (see drawSlot).
    char left[28];
    footerLeft(left, sizeof(left));
    char hintBuf[56];
    snprintf(hintBuf, sizeof(hintBuf), "%s  %s", left, actionHint());
    uiround::footer(*_tft, hintBuf, placed == 0 ? COL_DIM : COL_DIVIDER);
}

#endif  // HEXHOUND_PANEL_ROUND
